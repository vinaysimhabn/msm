## Documentation/devicetree/bindings/display/bridge/toshiba,tc358775.txt
```
Toshiba TC358775 DSI to LVDS bridge bindings

Required properties:
 - compatible: "toshiba,tc358775"
 - reg: i2c address of the bridge, 0x0f
 - tc, dsi-lanes: Number of DSI data lanes connected to the DSI host. It should
  be one of 1, 2, 3 or 4.
 - tc, dual-link : To configure the LVDS transmitter either
  as single-link or dual-link.
 - tc, data-format: To configure the data formats
   1 for VESA standard, 0 for JEIDA standard
 - vdd-supply: 1.2V LVDS Power Supply
 - vddio-supply: 1.8V IO Power Supply
 - stby-gpios: Standby pin, Low active 
 - reset-gpios: Hardware reset,	Low active 

Required nodes:

The TC358775 has two ports. Their connections are modelled using the OF
graph bindings specified in Documentation/devicetree/bindings/graph.txt.

- Video port 0 for the DSI input. The remote endpoint phandle should be a
	reference to a valid mipi_dsi_host device node.
- Video port 1 for the LVDS output.

Example:

	i2c@78b8000 {
		/* On High speed expansion */
		label = "HS-I2C2";
		status = "okay";

		tc_bridge: bridge@0f {
			status = "okay";

			compatible = "toshiba,tc358775";
			reg = <0x0f>;

			tc,dsi-lanes = <4>;
			tc,dual-link = <0>;

			vdd-supply = <&pm8916_l2>;
			vddio-supply = <&pm8916_l6>;

			stby-gpio = <&msmgpio 99 GPIO_ACTIVE_LOW>;
			reset-gpio = <&msmgpio 72 GPIO_ACTIVE_LOW>;

			ports {
				#address-cells = <1>;
				#size-cells = <0>;

				port@0 {
					reg = <0>;
					d2l_in: endpoint {
						remote-endpoint = <&dsi0_out>;
					};
				};

				port@1 {
					reg = <1>;
					d2l_out: endpoint {
						remote-endpoint = <&panel_in>;
					};
				};
			};
		};
	};

	panel: innolux,n116bge {
			status = "okay";
			compatible = "innolux,n116bge";
			power-supply = <&pm8916_l14>;

			port {
				panel_in: endpoint {
					remote-endpoint = <&d2l_out>;
				};
			};
	};

	mdss@1a00000 {
		status = "okay";

		mdp@1a01000 {
			status = "okay";
		};

		dsi@1a98000 {
			status = "okay";
			..
			ports {
				port@1 {
					dsi0_out: endpoint {
						remote-endpoint = <&d2l_in>;
						data-lanes = <0 1 2 3>;
					};
				};
			};
		};

		dsi-phy@1a98300 {
			status = "okay";
			..
		};
	};
```

## Documentation/devicetree/bindings/display/panel/jdi,acx450akm-7.txt
```
JDI model ACX450AKM-7 1080x1920 5" DSI Panel

Required properties:
- compatible: should be "jdi,acx450akm-7"
- avdd-supply: phandle of the regulator that provides the supply voltage
  AVDD supply (3-5V)
- iovcc-supply: phandle of the regulator that provides the supply voltage
  IOVDD , power supply (1.8V)
- reset-gpios: phandle of gpio for reset line
  XRES, HIGH active
- bklt-pwm-gpios: phandle of the gpio for power ic line
  Power IC supply enable, High active

Example:

	dsi0: qcom,mdss_dsi@4700000 {
		panel@0 {
			compatible = "jdi,acx450akm-7";
			reg = <0>;

			avdd-supply = <&pm8921_l8>;
                        iovdd-supply = <&pm8921_s4>;

                        reset-gpios = <&pm8821_mpps 2 GPIO_ACTIVE_HIGH>;
                        bklt-pwm-gpios = <&tlmm_pinmux 80 GPIO_ACTIVE_HIGH>;

                        port {
                                panel_in: endpoint {
                                        remote-endpoint = <&dsi0_out>;
                                };
                        };
		};
	};
```

## Documentation/devicetree/bindings/display/panel/jdi,lt070me05000.txt
```
JDI model LT070ME05000 1200x1920 7" DSI Panel

Required properties:
- compatible: should be "jdi,lt070me05000"
- power-supply: phandle of the regulator that provides the supply voltage
  IOVCC , power supply for LCM (1.8V)
- vddp-supply: phandle of the regulator that provides the supply voltage
  Power IC supply (3-5V)
- dcdc_en-supply: phandle of the regulator that provides the supply voltage
  Power IC supply enable, High active
- vcc-supply: phandle of the regulator that provides the supply voltage
  VDD, LED power supply (3-5V)
- reset-gpios: phandle of gpio for reset line
  This should be 8mA, gpio can be configured using mux, pinctrl, pinctrl-names
  XRES, Reset, Low active
- enable-gpios: phandle of gpio for enable line
  LED_EN, LED backlight enable, High active

Optional properties:
- pwm-gpio: phandle of gpio/pwm
  pwm backlight control, this should be mapped to the backlight level
  display brightness (0x51)  

Example:

	dsi0: qcom,mdss_dsi@4700000 {
		panel@0 {
			compatible = "jdi,lt070me05000";
			reg = <0>;
			pinctrl-names = "default";
			pinctrl-0 = <&dsi_panel_pinctrl>;

			power-supply = <&pm8921_lvs5>;
			vddp-supply = <&pm8921_l17>;
			dcdc_en-supply = <&pm8921_lvs7>;
			vcc-supply = <&pm8921_gpio 23 GPIO_ACTIVE_HIGH>;

			reset-gpios = <&tlmm_pinmux 54 0>;
			enable-gpios = <&pm8921_gpio 36 GPIO_ACTIVE_HIGH>;

			pwm-gpio = <&pm8921_gpio 26 GPIO_ACTIVE_HIGH>;
		};
	};
```

## Documentation/devicetree/bindings/display/panel/truly,otm8018b.txt
```
TRULY model TDO-FWVGA0402G90001 480x854 4" DSI Panel

Required properties:
- compatible: should be "truly,otm8018b"
- avdd-supply: phandle of the regulator that provides the supply voltage
  AVDD power supply (2.8V)
- iovdd-supply: phandle of the regulator that provides the supply voltage
  IOVDD  power supply (1.8V)
- reset-gpios: phandle of gpio for reset line
  RESET, HIGH active
- bklt-pwm-gpios: phandle of the gpio for power ic line
  Power IC supply enable, High active

Example:

	dsi0: qcom,mdss_dsi@4700000 {
		panel@0 {
			reg = <0>;
			compatible = "truly,otm8018b";

			avdd-supply = <&pm8921_l8>;
			iovdd-supply = <&pm8921_s4>;

			reset-gpios = <&pm8821_mpps 2 GPIO_ACTIVE_HIGH>;
			bklt-pwm-gpios = <&tlmm_pinmux 80 GPIO_ACTIVE_HIGH>;

			port {
				panel_in: endpoint {
					remote-endpoint = <&dsi0_out>;
				};
			};
		};

	};
```

## Documentation/devicetree/bindings/power_supply/smb347_charger.txt
```
smb347_charger bindings
~~~~~~~~~~~~~~~~~~~~~~~~

[Required porperties]
- compatible : "summit,smb347"
	       "summit,smb345"
- reg : Slave address for i2c interface
# At least one of followings should be set
  - enable-usb-charging
  - enable-otg-charging
  - enable-mains-charging

[Optional properties]
- interrupt-parent : The phandle for the interrupt controller
- interrupts : Interrupt line index for mapping
- enable-chg-ctrl : Enable charging control
		<0> : SW (i2c interface)
		<1> : Pin control (Active Low)
		<2> : Pin control (Active High)
# Charging constraints
- max-chg-curr : Maximum current for charging (in uA)
- max-chg-volt : Maximum voltage for charging (in uV)
- pre-chg-curr : Pre-charging current (in uA)
- term-curr : Charging cycle termination current (in uA)
- fast-volt-thershold : Voltage threshold to transit to fast charge mode (in uV)
- mains-curr-limit : Maximum input current from AC/DC input (in uA)
- usb-curr-limit : Maximum input current from USB input (in uA)

# Related thermometer monitoring (in degree C)
- chip-temp-threshold : Chip temperature for thermal regulaton.   <100, 130>
- soft-cold-temp-limit : Cold battery temperature for soft alarm. <0, 15>*
- soft-hot-temp-limit : Hot battery temperature for soft alarm.   <40, 55>
- hard-cold-temp-limit : Cold battery temperature for hard alarm. <0, 15>*
- hard-hot-temp-limit : Hot battery temperature for hard alarm.   <55, 65>
(* The written temperature has +5'C offset. 0'C -> -5'C, 15'C -> 10'C)
- soft-comp-method : Soft temperature limit compensation method
	(Not defined) : Use default setting
		<0> : Compensation none
		<1> : Charge current compensation
		<2> : Voltage compensation

Example:
	smb347@7f {
		compatible = "summit,smb347";
		reg = <0x7f>;
		status = "okay";

		max-chg-curr = <1800000>;
		mains-curr-limit = <2000000>;
		usb-curr-limit = <450000>;

		chip-temp-thershold = <110>;

		enable-usb-charging;
		enable-mains-charging;

		enable-chg-ctrl = <2>;	/* Pin control (Active High) */
	};
```
